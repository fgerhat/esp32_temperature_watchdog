## components/comp_htu21/Kconfig
```kconfig
menu "HTU21 Configuration"

    config HTU21_MAX_RETRIES_MEASUREMENT
        int "Maximum retry attempts when measurement is not done yet"
        range 1 10
        default 3

    config HTU21_MAX_RETRIES_CRC
        int "Maximum retry attempts when a CRC error occurs"
        range 1 10
        default 2

endmenu
```

## components/comp_i2c/Kconfig
```kconfig
menu "I2C Configuration"

    config I2C_SDA_PIN
        int "Data pin number (SDA)"
        range 0 40
        default 21

    config I2C_SCL_PIN
        int "Clock pin number (SCL)"
        range 0 40
        default 22

    choice I2C_CLOCK_SPEED
        prompt "I2C Clock Speed"
        default I2C_CLOCK_SPEED_100K
        config I2C_CLOCK_SPEED_100K
            bool "100 kHz"
        config I2C_CLOCK_SPEED_400K
            bool "400 kHz"
    endchoice

    config I2C_CLOCK_SPEED
        int
        default 100 if I2C_CLOCK_SPEED_100K
        default 400 if I2C_CLOCK_SPEED_400K

endmenu
```

## components/comp_mqtt/Kconfig
```kconfig
menu "MQTT Configuration"

    config MQTT_BROKER_URL
        string "Broker URL"
        default "maqiatto.com"

    config MQTT_USERNAME
        string "Username"

    config MQTT_PASSWORD
        string "Password"

endmenu
```

## components/comp_wifi/Kconfig
```kconfig
menu "Wi-Fi Configuration"

    config WIFI_MAX_RETRY_ATTEMPTS
        int "Maximum connection retry attempts"
        default 3
        range 0 255

    menu "Default WiFi Configuration"
        config WIFI_SSID
            string "SSID"

        config WIFI_PASSWORD
            string "Password"
    endmenu

endmenu
```

## main/Kconfig.projbuild
```kconfig
menu "Application Configuration"

    config WAKEUP_PERIOD_MINUTES
        int "Wake-up period [minutes]"
        range 1 60
        default 10
        help
            Time interval between wake-ups of the device.

endmenu
```
